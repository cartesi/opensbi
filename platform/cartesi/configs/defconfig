## platform/cartesi/configs/defconfig
```kconfig
CONFIG_FDT=y
CONFIG_FDT_DOMAIN=y
CONFIG_FDT_PMU=y
CONFIG_FDT_IPI=y
CONFIG_FDT_IRQCHIP=y
CONFIG_FDT_IRQCHIP_PLIC=y
CONFIG_FDT_RESET=y
CONFIG_FDT_RESET_HTIF=y
CONFIG_FDT_TIMER=y
CONFIG_FDT_TIMER_MTIMER=y
```
